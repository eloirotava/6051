## Documentation/devicetree/bindings/net/wireless/ssv,ssv6051.yaml
```yaml
# SPDX-License-Identifier: (GPL-2.0-only OR BSD-2-Clause)
%YAML 1.2
---
$id: http://devicetree.org/schemas/net/wireless/ssv,ssv6051.yaml#
$schema: http://devicetree.org/meta-schemas/core.yaml#

title: South Silicon Valley SSV6051 SDIO wireless LAN

maintainers:
  - Eloi Rotava <eloi@rotava.com>

description:
  The SSV6051 is a 2.4 GHz 802.11b/g/n chip with an SDIO interface.  The
  node describes SDIO function 1 and is a child of the MMC host.  All
  properties are optional; without them the driver assumes a 24 MHz
  crystal, the internal LDO and the default transmit power.  The bus
  clock is the one negotiated by the MMC core, lowered to 25 MHz only
  while the chip is brought up; limit it with the host's max-frequency
  if needed.

properties:
  compatible:
    const: ssv,ssv6051

  reg:
    description: SDIO function number.
    const: 1

  ssv,xtal-hz:
    description: Frequency of the crystal on the module.
    enum: [24000000, 26000000, 40000000]
    default: 24000000

  ssv,dcdc:
    type: boolean
    description:
      The chip is supplied through its DC-DC converter instead of the
      internal LDO.

  ssv,tx-gain-level:
    $ref: /schemas/types.yaml#/definitions/uint32
    description:
      Transmit power level, from 1 (highest) to 14 (lowest).  Without it
      the chip default is used.
    minimum: 1
    maximum: 14

required:
  - compatible
  - reg

additionalProperties: false

examples:
  - |
    mmc {
        #address-cells = <1>;
        #size-cells = <0>;

        wifi@1 {
            compatible = "ssv,ssv6051";
            reg = <1>;
            ssv,tx-gain-level = <14>;
        };
    };
```

## Kconfig
```kconfig
# SPDX-License-Identifier: GPL-2.0-only
config SSV6051
	tristate "South Silicon Valley SSV6051 SDIO wireless support"
	depends on MAC80211 && MMC
	help
	  This driver supports the South Silicon Valley (iComm) SSV6051
	  802.11b/g/n SDIO chip found in many TV boxes, in station and
	  access point mode.

	  It needs the firmware file ssv/ssv6051-sw.bin.

	  If you choose to build a module, it'll be called ssv6051.
```
